## Kconfig
```kconfig
config LALAPAD_TP_TUNER
    bool "tp-tuner over BT: GATT service on central, split forwarding to peripheral"
    default y
    depends on INPUT_IQS9151 && ZMK_SPLIT
    help
      Expose the IQS9151 runtime tuning commands over a custom GATT service
      on the central half and forward commands for the peripheral half over
      the ZMK split link (behavior invocation / input-split events).
```

## config/west.yml
```yaml
manifest:
  remotes:
    - name: zmkfirmware
      url-base: https://github.com/zmkfirmware
    - name: ShiniNet
      url-base: https://github.com/ShiniNet/
    - name: applepine1125
      url-base: https://github.com/applepine1125
    - name: caksoylar
      url-base: https://github.com/caksoylar
    - name: kot149
      url-base: https://github.com/kot149
  projects:
    - name: zmk
      remote: applepine1125
      revision: a007c7b20fed45d2a39a5b1784dc6163f84f1d35  # v0.3.0 + PR #3483(スクロール解像度の宣言)。ブランチ lalapad-v0.3.0
      import: app/west.yml
    - name: zmk-driver-iqs9151
      remote: applepine1125
      revision: debd8c49bcfdb4a6d10be5e7955aadb63bb17c4e
    - name: zmk-easy-charge-indicator
      remote: ShiniNet
      revision: v1.0.0
    - name: zmk-rgbled-widget
      remote: caksoylar
      revision: v0.3
    - name: zmk-scroll-snap
      remote: kot149
      revision: v1
  self:
    path: config
```

## dts/bindings/behaviors/lalapad,behavior-tp-param.yaml
```yaml
description: |
  tp-tuner の左手向けパラメータ転送 behavior。右手(central)が
  zmk_split_central_invoke_behavior で送り、左手(peripheral)で
  param1(パラメータ index または 0x8000 以上のオペコード)と param2(値)を実行する。

compatible: "lalapad,behavior-tp-param"

include: two_param.yaml
```

## dts/bindings/input/lalapad,tp-tuner-source.yaml
```yaml
description: |
  左手の tp_tuner_split_L(zmk,input-split)が要求する入力デバイス。
  tp-tuner のイベントは tp_tuner_peripheral.c が split 転送 API に直接渡すため、
  このデバイス自体は input_report を行わない。

compatible: "lalapad,tp-tuner-source"

include: base.yaml
```
